/*
Experimental Algorithm for variable color and variable distance without hard coding the colors before hand.
*/

#define S0 5
#define S1 6
#define S2 7
#define S3 8
#define sensor_output 9

#define led_red_pin 19
#define led_green_pin 20
#define led_blue_pin 21

//color red
int red_max_avg = 0;
int red_min_avg = 1000000;
  
//color green
int green_max_avg = 0 ;
int green_min_avg = 1000000 ;
  
//color blue
int blue_max_avg = 0 ;
int blue_min_avg = 1000000 ;

void setup() {
  pinMode(S0, OUTPUT);
  pinMode(S1, OUTPUT);
  pinMode(S2, OUTPUT);
  pinMode(S3, OUTPUT);
  pinMode(sensor_output, INPUT);
  pinMode(led_red_pin, OUTPUT);
  pinMode(led_red_pin, OUTPUT);
  pinMode(led_red_pin, OUTPUT);
  
  // Setting frequency-scaling to 20%
  digitalWrite(S0, HIGH);
  digitalWrite(S1, LOW);
  
  // Caliberation
  Serial.print("Caliberating the color red!");
  Serial.print("Keep the red object ready in front of the sensor in the least 'low-red' condition you want in under 5 sec!");
  delay(5000) ;
  
  for(int i=1;i<21;i++){
    
    int current_avg = 0 ;
    
    for(int j=1;j<101;j++){
      
      int frequency_red = 0 ;
      
      // Setting red filtered photodiodes to be read
      digitalWrite(S2, LOW);
      digitalWrite(S3, LOW);
      // Reading the output frequency
      frequency_red = pulseIn(sensor_output, LOW);
      current_avg = current_avg + frequency_red ;
      delay(50) ;
    }
    
    current_avg = current_avg/100 ;
    
    if(current_avg > red_max_avg){
      red_max_avg = current_avg ;
    }
  }
  
  Serial.print("Caliberating the color red!");
  Serial.print("Keep the red object ready in front of the sensor in the most 'high-red' condition you want in under 5 sec!");
  delay(5000) ;
  
  for(int i=1;i<21;i++){
    
    int current_avg = 0 ;
    
    for(int j=1;j<101;j++){
      
      int frequency_red = 0 ;
      
      // Setting red filtered photodiodes to be read
      digitalWrite(S2, LOW);
      digitalWrite(S3, LOW);
      // Reading the output frequency
      frequency_red = pulseIn(sensor_output, LOW);
      current_avg = current_avg + frequency_red ;
      delay(50) ;
    }
    
    current_avg = current_avg/100 ;
    
    if(current_avg < red_min_avg){
      red_min_avg = current_avg ;
    }
  }
  
  Serial.print("Caliberating the color green!");
  Serial.print("Keep the green object ready in front of the sensor in the 'low-green' condition you want in under 5 sec!");
  delay(5000) ;
  
  for(int i=1;i<21;i++){
    
    int current_avg = 0 ;
    
    for(int j=1;j<101;j++){
      
      int frequency_green = 0 ;
      
      // Setting red filtered photodiodes to be read
      digitalWrite(S2, LOW);
      digitalWrite(S3, LOW);
      // Reading the output frequency
      frequency_green = pulseIn(sensor_output, LOW);
      current_avg = current_avg + frequency_green ;
      delay(50) ;
    }
    
    current_avg = current_avg/100 ;
    
    if(current_avg > green_max_avg){
      green_max_avg = current_avg ;
    }
  }
    
  Serial.print("Caliberating the color green!");
  Serial.print("Keep the green object ready in front of the sensor in the 'high-green' condition you want in under 5 sec!");
  delay(5000) ;
  
  for(int i=1;i<21;i++){
    
    int current_avg = 0 ;
    
    for(int j=1;j<101;j++){
      
      int frequency_green = 0 ;
      
      // Setting red filtered photodiodes to be read
      digitalWrite(S2, LOW);
      digitalWrite(S3, LOW);
      // Reading the output frequency
      frequency_green = pulseIn(sensor_output, LOW);
      current_avg = current_avg + frequency_green ;
      delay(50) ;
    }
    
    current_avg = current_avg/100 ;
    
    if(current_avg < green_min_avg){
      green_min_avg = current_avg ;
    }
  }
    
  Serial.print("Caliberating the color blue!");
  Serial.print("Keep the red object ready in front of the sensor in the most 'low-blue' condition you want in under 5 sec!");
  delay(5000) ;
  
  for(int i=1;i<21;i++){
    
    int current_avg = 0 ;
    
    for(int j=1;j<101;j++){
      
      int frequency_blue = 0 ;
      
      // Setting red filtered photodiodes to be read
      digitalWrite(S2, LOW);
      digitalWrite(S3, LOW);
      // Reading the output frequency
      frequency_blue = pulseIn(sensor_output, LOW);
      current_avg = current_avg + frequency_blue ;
      delay(50) ;
    }
    
    current_avg = current_avg/100 ;
    
    if(current_avg > blue_max_avg){
      blue_max_avg = current_avg ;
    }
  }
    
  Serial.print("Caliberating the color blue!");
  Serial.print("Keep the red object ready in front of the sensor in the most 'high-blue' condition you want in under 5 sec!");
  delay(5000) ;
  
  for(int i=1;i<21;i++){
    
    int current_avg = 0 ;
    
    for(int j=1;j<101;j++){
      
      int frequency_blue = 0 ;
      
      // Setting red filtered photodiodes to be read
      digitalWrite(S2, LOW);
      digitalWrite(S3, LOW);
      // Reading the output frequency
      frequency_blue = pulseIn(sensor_output, LOW);
      current_avg = current_avg + frequency_blue ;
      delay(50) ;
    
    }
    
    current_avg = current_avg/100 ;
    
    if(current_avg < blue_min_avg){
      blue_min_avg = current_avg ;
    }
  
  }
  
}

void loop(){
  
  int red_frequency_avg = 0 ;
  int green_frequency_avg = 0 ;
  int blue_frequency_avg = 0 ;
  
  int red_light_val = 0 ;
  int green_light_val = 0 ;
  int blue_light_val = 0 ;
  
  //reading the color
  Serial.print("Please keep the object for which color is to sensed!, in 5 seconds") ;
  delay(5000) ;
  
  for(int i=1;i<1001;i++){
    
    //reading the data
    Serial.print("Keep the device steady at a fixed location in front of the object. Preferably keep the device near the object!");
    Serial.print("Reading Start!");
    // reading data from red filters.
    digitalWrite(S2, LOW);
    digitalWrite(S3, LOW);
    red_frequency_avg = red_frequency_avg + pulseIn(sensor_output, LOW);
    delay(50) ;
  
    //reading data from green filters.
    digitalWrite(S2, HIGH);
    digitalWrite(S3, HIGH);
    green_frequency_avg = green_frequency_avg + pulseIn(sensor_output, LOW);
    delay(50) ;
  
    //reading data from blue filters.
    digitalWrite(S2, LOW);
    digitalWrite(S3, HIGH);
    blue_frequency_avg = blue_frequency_avg + pulseIn(sensor_output, LOW);
    delay(50) ;
  }
  
  Serial.print("Reading End!");
  
  red_frequency_avg = (red_frequency_avg/1000) ;
  green_frequency_avg = (green_frequency_avg/1000) ;
  blue_frequency_avg = (blue_frequency_avg/1000) ;
  
  
  //Converting the data from the sensor led value.
  red_light_val = map(red_frequency_avg, red_min_avg, red_max_avg, 255, 0) ;
  green_light_val = map(green_frequency_avg, green_min_avg, green_max_avg, 255, 0) ;
  blue_light_val = map(blue_frequency_avg, blue_min_avg, blue_max_avg, 255, 0) ;
  
  //illuminating the rgb led according to the results.
  analogWrite(led_red_pin, red_light_val);
  analogWrite(led_green_pin, green_light_val);
  analogWrite(led_blue_pin, blue_light_val);
}
